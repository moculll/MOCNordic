## CMakeLists.txt
```
#
# Copyright (c) 2024 Nordic Semiconductor
#
# SPDX-License-Identifier: LicenseRef-Nordic-5-Clause
#

cmake_minimum_required(VERSION 3.20.0)
#set(CMAKE_EXPORT_COMPILE_COMMANDS ON)
find_package(Zephyr REQUIRED HINTS $ENV{ZEPHYR_BASE})

project(MOCNordicDongle)


add_subdirectory(MOCNordic)

target_sources(app PRIVATE src/main.cpp)

target_include_directories(app PRIVATE 
    MOCNordic/include
)

target_link_libraries(app PRIVATE MOCNordic)
```

## prj.conf
```kconfig
CONFIG_LOG_MODE_MINIMAL=y
CONFIG_LOG_DEFAULT_LEVEL=3
CONFIG_LOG=y
# CONFIG_DEBUG=y  
# CONFIG_LOG_PRINTK=y  
# CONFIG_LOG_BUFFER_SIZE=4096    
# CONFIG_LOG_MODE_IMMEDIATE=y      
CONFIG_REQUIRES_FLOAT_PRINTF=y  

CONFIG_DK_LIBRARY=y
CONFIG_CPP=y
CONFIG_STD_CPP17=y
CONFIG_REQUIRES_FULL_LIBCPP=y
CONFIG_SYSTEM_CLOCK_WAIT_FOR_STABILITY=y
CONFIG_SCHED_SCALABLE=y
CONFIG_MPU_STACK_GUARD=y
CONFIG_HEAP_MEM_POOL_SIZE=2048
CONFIG_SYSTEM_WORKQUEUE_STACK_SIZE=4096

CONFIG_USB_DEVICE_STACK=y
CONFIG_USB_DEVICE_HID=y
CONFIG_USB_DEVICE_PRODUCT="MOCNordicTest"
CONFIG_USB_DEVICE_VID=0x1529
CONFIG_USB_DEVICE_PID=0x2061
CONFIG_USB_DEVICE_INITIALIZE_AT_BOOT=n
CONFIG_USB_HID_DEVICE_COUNT=5
CONFIG_USB_HID_POLL_INTERVAL_MS=1
CONFIG_USB_COMPOSITE_DEVICE=y
CONFIG_ENABLE_HID_INT_OUT_EP=y
CONFIG_HID_INTERRUPT_EP_MPS=64
CONFIG_USB_WORKQUEUE_STACK_SIZE=4096
CONFIG_USB_REQUEST_BUFFER_SIZE=512
CONFIG_USB_NRFX_WORK_QUEUE_STACK_SIZE=8192
CONFIG_USB_MAX_NUM_TRANSFERS=5
CONFIG_USB_DEVICE_BOS=n
CONFIG_USB_DEVICE_OS_DESC=n



CONFIG_BT=y
CONFIG_BT_CENTRAL=y
CONFIG_BT_SMP=y
# CONFIG_BT_FIXED_PASSKEY=y  
#CONFIG_BT_SMP_SC_ONLY=n
CONFIG_BT_GATT_DM=y
CONFIG_BT_MAX_CONN=5
#CONFIG_BT_GAP_AUTO_UPDATE_CONN_PARAMS=y
CONFIG_BT_MAX_PAIRED=5
CONFIG_BT_GATT_DM_DATA_PRINT=y
#CONFIG_BT_GATT_DM_WORKQ_OWN=n
CONFIG_BT_GATT_DM_WORKQ_SYS=y
CONFIG_BT_GATT_AUTO_DISCOVER_CCC=y
CONFIG_BT_FILTER_ACCEPT_LIST=y
CONFIG_BT_SCAN=y
CONFIG_BT_SCAN_FILTER_ENABLE=y
CONFIG_BT_SCAN_UUID_CNT=5
CONFIG_BT_SCAN_NAME_CNT=5
CONFIG_BT_SCAN_SHORT_NAME_CNT=5
CONFIG_BT_SCAN_ADDRESS_CNT=5
CONFIG_BT_GATT_CLIENT=y
CONFIG_BT_GATT_DM_MAX_ATTRS=100
CONFIG_BT_GATT_AUTO_UPDATE_MTU=y  
CONFIG_BT_L2CAP_TX_MTU=247
CONFIG_BT_L2CAP_TX_BUF_COUNT=8
CONFIG_BT_EXT_ADV=y

CONFIG_BT_EXT_SCAN_BUF_SIZE=128
CONFIG_BT_BUF_ACL_RX_SIZE=128
CONFIG_BT_BUF_ACL_TX_SIZE=128
CONFIG_BT_BUF_ACL_RX_COUNT=8
CONFIG_BT_HCI_TX_STACK_SIZE=2048
CONFIG_BT_RX_STACK_SIZE=2048
CONFIG_BT_ATT_TX_COUNT=16
```

## src/main.cpp
```c
#include <zephyr/kernel.h>
#include <zephyr/sys/ring_buffer.h>
#include <bluetooth/hci_vs_sdc.h>
#include <zephyr/bluetooth/bluetooth.h>
#include <zephyr/bluetooth/addr.h>
#include <zephyr/bluetooth/conn.h>
#include <zephyr/bluetooth/hci.h>
#include <zephyr/logging/log.h>
#include <zephyr/bluetooth/gatt.h>
#include <zephyr/bluetooth/uuid.h>
#include <bluetooth/gatt_dm.h>
#include <zephyr/usb/usb_device.h>
#include <zephyr/usb/usbd.h>
#include <zephyr/usb/class/usb_hid.h>
#include <MOCNordic/MOCNordicBLEMgr.h>
#include <MOCNordic/MOCNordicLogger.h>
#include <MOCNordic/MOCNordicHIDevice.h>
#include <dk_buttons_and_leds.h>

LOG_MODULE_REGISTER(main, CONFIG_LOG_DEFAULT_LEVEL);

class BLEDevice {
public:
    explicit BLEDevice(std::string_view deviceName) : name(deviceName)
    {
        k_sem_init(&connectSem, 0, 1);
    }

    void connect()
    {
        MOCNordic::MOCNordicBLEMgr::setScanTarget(name);
    }


    void init()
    {
        auto index = MOCNordic::MOCNordicBLEMgr::getAvailableIndex();
        DEBUG_PRINT("get available index: %d", index);
        MOCNordic::MOCNordicBLEMgr::registerGetReportMapCallbackToIndex(index, [this, index](uint8_t *data, uint32_t length) {
            MOCNordic::ReportDesc desc;
            desc.clear();
            desc.insert(data, length, MOCNordic::ReportDescType::UNKNOWN);
            
            
            MOCNordic::MOCNordicHIDevice::deviceUnitInit(index, desc);
            k_sem_give(&connectSem);
            
        });

        MOCNordic::MOCNordicBLEMgr::registerNotifyToIndex(index, [index](uint8_t *data, uint32_t length){
            if(!length || !data)
                return;

            MOCNordic::MOCNordicHIDevice::writeToDevice(index, data, length);

        });
    }

    void waitForConnect(uint32_t timeoutMs)
    {
        k_sem_take(&connectSem, K_MSEC(timeoutMs));
    }


private:
    const std::string name;
    struct k_sem connectSem;
    
};

int main(void)
{
    
    /* int err = dk_buttons_init(button_handler);
    
	if (err) {
		DEBUG_PRINT("Failed to initialize buttons (err %d)", err);
		return 0;
    } */

	if(!MOCNordic::MOCNordicBLEMgr::BLEStackInit()) {
        DEBUG_PRINT("moc nordic ble stack init successful.");
    }

    if(!MOCNordic::MOCNordicHIDevice::init()) {
        DEBUG_PRINT("moc nordic hid init successful.");
    }

    BLEDevice touchPadDevice("Brydge C-Touch");
    touchPadDevice.init();
    touchPadDevice.connect();
    touchPadDevice.waitForConnect(2000000);

    BLEDevice mouseDevice("Mouse");
    mouseDevice.init();
    mouseDevice.connect();
    mouseDevice.waitForConnect(2000000);

    BLEDevice keyboardDevice("Keyboard");
    keyboardDevice.init();
    keyboardDevice.connect();
    keyboardDevice.waitForConnect(2000000);

    DEBUG_PRINT("all device connected.");
    while(1) {
        
        k_msleep(1000000000);

    }

}
```
